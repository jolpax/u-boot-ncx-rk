## board/rockchip/ncx_rk3568/Kconfig
```kconfig
if TARGET_NCX_RK3568

config SYS_BOARD
	default "ncx_rk3568"

config SYS_VENDOR
	default "rockchip"

config SYS_CONFIG_NAME
	default "ncx_rk3568"

config BOARD_SPECIFIC_OPTIONS # dummy
	def_bool y

endif
```
